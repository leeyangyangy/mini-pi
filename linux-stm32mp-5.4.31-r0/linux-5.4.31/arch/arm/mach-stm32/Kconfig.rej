## linux-stm32mp-5.4.31-r0/linux-5.4.31/arch/arm/mach-stm32/Kconfig.rej
```kconfig
--- arch/arm/mach-stm32/Kconfig
+++ arch/arm/mach-stm32/Kconfig
@@ -46,6 +46,7 @@ if ARCH_MULTI_V7
 config MACH_STM32MP157
 	bool "STMicroelectronics STM32MP157"
 	select ARM_ERRATA_814220
+	select REGULATOR
 	default y
 
 endif # ARMv7-A
```
